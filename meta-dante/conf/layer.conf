## meta-dante/conf/layer.conf
```bitbake
# We have a conf and classes directory, add to BBPATH
BBPATH .= ":${LAYERDIR}"

# We have recipes-* directories, add to BBFILES
BBFILES += "${LAYERDIR}/recipes-*/*/*.bb \
            ${LAYERDIR}/recipes-*/*/*.bbappend"

BBFILE_COLLECTIONS += "meta-dante"
BBFILE_PATTERN_meta-dante = "^${LAYERDIR}/"
BBFILE_PRIORITY_meta-dante = "6"

LAYERDEPENDS_meta-dante = "core"
LAYERSERIES_COMPAT_meta-dante = "scarthgap"


# audinate out-of-kernel modules want this version
PREFERRED_VERSION_linux-xlnx = "5.15%"
```

## meta-dante/recipes-modules/akashi-reg/files/Kconfig
```kconfig
#
# Akashi Register Interface device configuration
#

config AKASHI_REG
	tristate "Akashi-Register Interface device"
	default m
	help
		Audinate Akashi Register Interface device driver support.

config AKASHI_REG_DYNAMIC_MAJOR
	bool "Use dynamic major number"
	depends on AKASHI_REG
	default n
	help
		This feature requires kernel support to allocate a device major number when
		registering a character device.

config AKASHI_REG_RX_BUNDLE_ACTIVITY
	bool "Support rx bundle activity event"
	depends on AKASHI_REG
	default y

config AKASHI_REG_METERINGEV
	bool "Support metering event"
	depends on AKASHI_REG
	default y

config AKASHI_REG_KA_MISS
	bool "Support ka miss event"
	depends on AKASHI_REG
	default y

config AKASHI_REG_AERR
	bool "Support APE flow error event"
	depends on AKASHI_REG
	default y

config AKASHI_REG_KAEV
	bool "Support APE ka event"
	depends on AKASHI_REG
	default y

config AKASHI_REG_SPI_HP
	bool "Support SPI slave event for hostprocessor"
	depends on AKASHI_REG
	default n
```

## meta-enghost/conf/distro/digico-enghost-linux.conf
```bitbake
require conf/distro/poky-tiny.conf

DISTRO = "digico-enghost-linux"
DISTRO_NAME = "DiGiCo Enghost Linux"
DISTROOVERRIDES:append = ":digico"
DISTRO_VERSION = "1.0.0"

PACKAGE_CLASSES = "package_ipk"

TCLIBC = "glibc"

IMAGE_FSTYPES += "cpio.gz.u-boot"

UBOOT_SUFFIX = "bin"

DISTRO_FEATURES = " \
    ipv4 \
    ipv6 \
    usbhost \
    sysvinit \
"

# Would like to use busybox-init, but the init scripts seem half-baked and
# couldn't get update-rc.d working properly
INIT_MANAGER="sysvinit"

# Using our own initscripts rather than the "initscripts" package which is set by default for sysvinit
VIRTUAL-RUNTIME_initscripts = "enghost-initscripts"
PREFERRED_RPROVIDER_initd-functions = "enghost-initscripts"

DISTRO_FEATURES_BACKFILL_CONSIDERED:append = " pulseaudio gobject-introspection-data"

# poky-tiny wants linux-yocto-tiny, but we need xilinx kernel
PREFERRED_PROVIDER_virtual/kernel = "linux-xlnx"
PREFERRED_VERSION_linux-xlnx = "5.15%"

# XRT requires a specific ocl implementation
SKIP_RECIPE[opencl-icd-loader] = "Not supported, only ocl-icd is supported at this time."
PREFERRED_PROVIDER_virtual/opencl-icd = "ocl-icd"

ENABLE_BINARY_LOCALE_GENERATION = "0"


INITRAMFS_IMAGE = "enghost-image"
INITRAMFS_IMAGE_BUNDLE = "1"

KERNEL_CLASSES += "kernel-fitimage"
KERNEL_IMAGETYPES:append = " fitImage"

UBOOT_ENTRYPOINT:zynq  = "0x8000"
UBOOT_LOADADDRESS:zynq = "0x8000"

SANITY_TESTED_DISTROS:append = " rocky-9.4"
```

## meta-enghost/conf/layer.conf
```bitbake
# We have a conf and classes directory, add to BBPATH
BBPATH .= ":${LAYERDIR}"

# We have recipes-* directories, add to BBFILES
BBFILES += "${LAYERDIR}/recipes-*/*/*.bb \
            ${LAYERDIR}/recipes-*/*/*.bbappend"

BBFILE_COLLECTIONS += "meta-enghost"
BBFILE_PATTERN_meta-enghost = "^${LAYERDIR}/"
BBFILE_PRIORITY_meta-enghost = "6"

LAYERDEPENDS_meta-enghost = "core"
LAYERSERIES_COMPAT_meta-enghost = "scarthgap"
```

## meta-enghost/recipes-core/images/files/main_image.its
```
/dts-v1/;

/ {
        description = "Kernel fitImage for DiGiCo Enghost Linux/5.15.19+git/p16380";
        #address-cells = <1>;

        images {
                kernel-1 {
                        description = "Linux kernel";
                        data = /incbin/("linux.bin");
                        type = "kernel";
                        arch = "arm";
                        os = "linux";
                        compression = "none";
                        load = <0x200000>;
                        entry = <0x200000>;
                        hash-1 {
                                algo = "sha256";
                        };
                };
                fdt-system-top.dtb {
                        description = "Flattened Device Tree blob";
                        data = /incbin/("/home/digico/babyshark-enghost/poky/build/tmp/work/p16380-poky-linux-gnueabi/linux-xlnx/5.15.19+git/recipe-sysroot/boot/devicetree/system-top.dtb");
                        type = "flat_dt";
                        arch = "arm";
                        compression = "none";
                        
                        hash-1 {
                                algo = "sha256";
                        };
                };
	};

        configurations {
                default = "conf-system-top.dtb";
                conf-system-top.dtb {
                        description = "1 Linux kernel, FDT blob";
                        compatible = "xlnx,zynq-7000";
                        kernel = "kernel-1";
                        fdt = "fdt-system-top.dtb";
                        
                        
                        
                        hash-1 {
                                algo = "sha256";
                        };
                };
	};
};
```

## meta-klante-module/conf/layer.conf
```bitbake
# We have a conf and classes directory, add to BBPATH
BBPATH .= ":${LAYERDIR}"

# We have recipes-* directories, add to BBFILES
BBFILES += "${LAYERDIR}/recipes-*/*/*.bb \
            ${LAYERDIR}/recipes-*/*/*.bbappend"

BBFILE_COLLECTIONS += "meta-klante-module"
BBFILE_PATTERN_meta-klante-module = "^${LAYERDIR}/"
BBFILE_PRIORITY_meta-klante-module = "6"

LAYERDEPENDS_meta-klante-module = "core"
LAYERSERIES_COMPAT_meta-klante-module = "scarthgap"
```

## meta-klante-module/conf/machine/klante-module.conf
```bitbake
#@TYPE: Machine
#@NAME: klante-module

# fucked up way of saying MACHINEOVERRIDES = 'klante-module' if MACHINE == 'klante-module' else ''
MACHINEOVERRIDES =. "${@['', 'klante-module:']['klante-module' !='${MACHINE}']}"

# zynq-generic sets this to zc702 device tree, we dont want all that trash
YAML_DT_BOARD_FLAGS = ""

INITRAMFS_IMAGE="enghost-image"

require conf/machine/zynq-generic.conf
```

## meta-p16380/conf/layer.conf
```bitbake
# We have a conf and classes directory, add to BBPATH
BBPATH .= ":${LAYERDIR}"

# We have recipes-* directories, add to BBFILES
BBFILES += "${LAYERDIR}/recipes-*/*/*.bb \
            ${LAYERDIR}/recipes-*/*/*.bbappend"

BBFILE_COLLECTIONS += "meta-p16380"
BBFILE_PATTERN_meta-p16380 = "^${LAYERDIR}/"
BBFILE_PRIORITY_meta-p16380 = "6"

LAYERDEPENDS_meta-p16380 = "core"
LAYERSERIES_COMPAT_meta-p16380 = "scarthgap"
```

## meta-p16380/conf/machine/p16380.conf
```bitbake
#@TYPE: Machine
#@NAME: p16380

MACHINEOVERRIDES =. "${@['', 'p16380:']['p16380' !='${MACHINE}']}"

# zynq-generic sets this to zc702 device tree, we dont want all that trash
YAML_DT_BOARD_FLAGS = ""

MACHINE_FEATURES_BACKFILL_CONSIDERED = "qemu-usermode"

IMAGE_INSTALL += "eth-internal-delay-bodge"

XILINX_WITH_ESW = "no_thanks"

require conf/machine/zynq-generic.conf
```

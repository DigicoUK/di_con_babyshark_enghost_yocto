/dts-v1/;
/plugin/;

&spi0 {
    fpga23_flash: flash@0 {
        #address-cells = <1>;
        #size-cells = <1>;
        reg = <0>;
        status = "ok";
        compatible = "jedec,spi-nor";
        spi-max-frequency = <4000000>;
    };
};
